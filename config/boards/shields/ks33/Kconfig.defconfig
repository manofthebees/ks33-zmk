## config/boards/shields/ks33/Kconfig.defconfig
```kconfig
if SHIELD_KS33_LEFT
 
config ZMK_KEYBOARD_NAME
    default "ks33"
 
config ZMK_SPLIT_ROLE_CENTRAL
    default y
 
endif
 
if SHIELD_KS33_LEFT || SHIELD_KS33_RIGHT
 
config ZMK_SPLIT
    default y
 
endif
```

## config/boards/shields/ks33/Kconfig.shield
```kconfig
config SHIELD_KS33_LEFT
    def_bool $(shields_list_contains,ks33_left)
    select SHIELD_KS33

config SHIELD_KS33_RIGHT
    def_bool $(shields_list_contains,ks33_right)
    select SHIELD_KS33
```
