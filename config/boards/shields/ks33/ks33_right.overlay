#include "ks33.dtsi"

&default_transform { // The matrix transform for this board is 5
    col-offset = <5>;
};

&kscan0 {
    row-gpios
        = <&gpio0 2  (GPIO_ACTIVE_HIGH | GPIO_PULL_DOWN)>    // R0 = P0.02
        , <&gpio1 15 (GPIO_ACTIVE_HIGH | GPIO_PULL_DOWN)>    // R1 = P1.15
        , <&gpio1 13 (GPIO_ACTIVE_HIGH | GPIO_PULL_DOWN)>    // R2 = P1.13
        , <&gpio1 11 (GPIO_ACTIVE_HIGH | GPIO_PULL_DOWN)>    // R3 = P1.11
        ;

    col-gpios
        = <&gpio0 20 GPIO_ACTIVE_HIGH>    // C0 = P0.20
        , <&gpio0 17 GPIO_ACTIVE_HIGH>    // C1 = P0.17
        , <&gpio0 22 GPIO_ACTIVE_HIGH>    // C2 = P0.22
        , <&gpio0 24 GPIO_ACTIVE_HIGH>    // C3 = P0.24
        , <&gpio1 0  GPIO_ACTIVE_HIGH>    // C4 = P1.00
        ;
};